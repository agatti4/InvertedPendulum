## west.yml
```yaml
manifest:
  version: "0.13"

  remotes:
    - name: zephyr
      url-base: https://github.com/zephyrproject-rtos

  projects:
    - name: zephyr
      remote: zephyr
      revision: v4.4.0
      import:
        name-allowlist:
          - cmsis_6
          - hal_st
          - hal_stm32

  self:
    path: .
```
